## zephyr_app/stm32/nucleo_g474re/blinky/build_test/Kconfig/arch/Kconfig.tmp
```kconfig
# Load Zephyr Arch Kconfig descriptions.
osource "/home/user/work/zephyr_dev/zephyr/arch/rx/Kconfig"
osource "/home/user/work/zephyr_dev/zephyr/arch/x86/Kconfig"
osource "/home/user/work/zephyr_dev/zephyr/arch/xtensa/Kconfig"
osource "/home/user/work/zephyr_dev/zephyr/arch/sparc/Kconfig"
osource "/home/user/work/zephyr_dev/zephyr/arch/riscv/Kconfig"
osource "/home/user/work/zephyr_dev/zephyr/arch/posix/Kconfig"
osource "/home/user/work/zephyr_dev/zephyr/arch/openrisc/Kconfig"
osource "/home/user/work/zephyr_dev/zephyr/arch/mips/Kconfig"
osource "/home/user/work/zephyr_dev/zephyr/arch/arm64/Kconfig"
osource "/home/user/work/zephyr_dev/zephyr/arch/arm/Kconfig"
osource "/home/user/work/zephyr_dev/zephyr/arch/arc/Kconfig"
```

## zephyr_app/stm32/nucleo_g474re/blinky/build_test/Kconfig/boards/Kconfig.defconfig.tmp
```kconfig
# Load Zephyr board defconfig descriptions.
osource "/home/user/work/zephyr_dev/zephyr/boards/st/nucleo_g474re/Kconfig.defconfig"
```

## zephyr_app/stm32/nucleo_g474re/blinky/build_test/Kconfig/boards/Kconfig.nucleo_g474re
```kconfig
# Load board Kconfig descriptions.
osource "/home/user/work/zephyr_dev/zephyr/boards/st/nucleo_g474re/Kconfig.nucleo_g474re"
```

## zephyr_app/stm32/nucleo_g474re/blinky/build_test/Kconfig/boards/Kconfig.sysbuild.tmp
```kconfig
# Load Sysbuild board Kconfig descriptions.
osource "/home/user/work/zephyr_dev/zephyr/boards/st/nucleo_g474re/Kconfig.sysbuild"
```

## zephyr_app/stm32/nucleo_g474re/blinky/build_test/Kconfig/soc/Kconfig
```kconfig
# Load Zephyr SoC Kconfig descriptions.
osource "/home/user/work/zephyr_dev/zephyr/soc/xlnx/zynqmp/Kconfig"
osource "/home/user/work/zephyr_dev/zephyr/soc/xlnx/zynq7000/Kconfig"
osource "/home/user/work/zephyr_dev/zephyr/soc/xlnx/versalnet/Kconfig"
osource "/home/user/work/zephyr_dev/zephyr/soc/xlnx/versal2/Kconfig"
osource "/home/user/work/zephyr_dev/zephyr/soc/xlnx/versal/Kconfig"
osource "/home/user/work/zephyr_dev/zephyr/soc/xen/Kconfig"
osource "/home/user/work/zephyr_dev/zephyr/soc/wch/ch32v/Kconfig"
osource "/home/user/work/zephyr_dev/zephyr/soc/ti/simplelink/Kconfig"
osource "/home/user/work/zephyr_dev/zephyr/soc/ti/mspm0/Kconfig"
osource "/home/user/work/zephyr_dev/zephyr/soc/ti/lm3s6965/Kconfig"
osource "/home/user/work/zephyr_dev/zephyr/soc/ti/k3/Kconfig"
osource "/home/user/work/zephyr_dev/zephyr/soc/telink/tlsr/Kconfig"
osource "/home/user/work/zephyr_dev/zephyr/soc/syna/sr100/Kconfig"
osource "/home/user/work/zephyr_dev/zephyr/soc/starfive/jh71xx/Kconfig"
osource "/home/user/work/zephyr_dev/zephyr/soc/st/stm32/Kconfig"
osource "/home/user/work/zephyr_dev/zephyr/soc/snps/qemu_arc/Kconfig"
osource "/home/user/work/zephyr_dev/zephyr/soc/snps/nsim/arc_v/Kconfig"
osource "/home/user/work/zephyr_dev/zephyr/soc/snps/nsim/arc_classic/Kconfig"
osource "/home/user/work/zephyr_dev/zephyr/soc/snps/hsdk4xd/Kconfig"
osource "/home/user/work/zephyr_dev/zephyr/soc/snps/hsdk/Kconfig"
osource "/home/user/work/zephyr_dev/zephyr/soc/snps/emsk/Kconfig"
osource "/home/user/work/zephyr_dev/zephyr/soc/snps/emsdp/Kconfig"
osource "/home/user/work/zephyr_dev/zephyr/soc/snps/arc_iot/Kconfig"
osource "/home/user/work/zephyr_dev/zephyr/soc/silabs/Kconfig"
osource "/home/user/work/zephyr_dev/zephyr/soc/sifli/sf32/Kconfig"
osource "/home/user/work/zephyr_dev/zephyr/soc/sifive/sifive_freedom/Kconfig"
osource "/home/user/work/zephyr_dev/zephyr/soc/sensry/Kconfig"
osource "/home/user/work/zephyr_dev/zephyr/soc/rockchip/Kconfig"
osource "/home/user/work/zephyr_dev/zephyr/soc/renode/riscv_virtual/Kconfig"
osource "/home/user/work/zephyr_dev/zephyr/soc/renode/cortex_r8_virtual/Kconfig"
osource "/home/user/work/zephyr_dev/zephyr/soc/renesas/smartbond/Kconfig"
osource "/home/user/work/zephyr_dev/zephyr/soc/renesas/rz/Kconfig"
osource "/home/user/work/zephyr_dev/zephyr/soc/renesas/rx/Kconfig"
osource "/home/user/work/zephyr_dev/zephyr/soc/renesas/rcar/Kconfig"
osource "/home/user/work/zephyr_dev/zephyr/soc/renesas/ra/Kconfig"
osource "/home/user/work/zephyr_dev/zephyr/soc/realtek/fingerprint/Kconfig"
osource "/home/user/work/zephyr_dev/zephyr/soc/realtek/ec/Kconfig"
osource "/home/user/work/zephyr_dev/zephyr/soc/realtek/bee/Kconfig"
osource "/home/user/work/zephyr_dev/zephyr/soc/realtek/ameba/Kconfig"
osource "/home/user/work/zephyr_dev/zephyr/soc/raspberrypi/rpi_pico/Kconfig"
osource "/home/user/work/zephyr_dev/zephyr/soc/quicklogic/eos_s3/Kconfig"
osource "/home/user/work/zephyr_dev/zephyr/soc/qemu/virt_riscv/Kconfig"
osource "/home/user/work/zephyr_dev/zephyr/soc/qemu/or1k/Kconfig"
osource "/home/user/work/zephyr_dev/zephyr/soc/qemu/malta/Kconfig"
osource "/home/user/work/zephyr_dev/zephyr/soc/openisa/rv32m1/Kconfig"
osource "/home/user/work/zephyr_dev/zephyr/soc/openhwgroup/cva6/Kconfig"
osource "/home/user/work/zephyr_dev/zephyr/soc/oct/osd32mp15x/Kconfig"
osource "/home/user/work/zephyr_dev/zephyr/soc/nxp/s32/Kconfig"
osource "/home/user/work/zephyr_dev/zephyr/soc/nxp/rw/Kconfig"
osource "/home/user/work/zephyr_dev/zephyr/soc/nxp/mcx/Kconfig"
osource "/home/user/work/zephyr_dev/zephyr/soc/nxp/lpc/Kconfig"
osource "/home/user/work/zephyr_dev/zephyr/soc/nxp/layerscape/Kconfig"
osource "/home/user/work/zephyr_dev/zephyr/soc/nxp/kinetis/Kconfig"
osource "/home/user/work/zephyr_dev/zephyr/soc/nxp/imxrt/Kconfig"
osource "/home/user/work/zephyr_dev/zephyr/soc/nxp/imx/Kconfig"
osource "/home/user/work/zephyr_dev/zephyr/soc/nuvoton/numicro/Kconfig"
osource "/home/user/work/zephyr_dev/zephyr/soc/nuvoton/numaker/Kconfig"
osource "/home/user/work/zephyr_dev/zephyr/soc/nuvoton/npcx/Kconfig"
osource "/home/user/work/zephyr_dev/zephyr/soc/nuvoton/npcm/Kconfig"
osource "/home/user/work/zephyr_dev/zephyr/soc/nordic/Kconfig"
osource "/home/user/work/zephyr_dev/zephyr/soc/neorv32/Kconfig"
osource "/home/user/work/zephyr_dev/zephyr/soc/native/inf_clock/Kconfig"
osource "/home/user/work/zephyr_dev/zephyr/soc/microchip/sam/sama7/Kconfig"
osource "/home/user/work/zephyr_dev/zephyr/soc/microchip/sam/sam_d5x_e5x/Kconfig"
osource "/home/user/work/zephyr_dev/zephyr/soc/microchip/pic64/Kconfig"
osource "/home/user/work/zephyr_dev/zephyr/soc/microchip/pic32c/pic32cz_ca/Kconfig"
osource "/home/user/work/zephyr_dev/zephyr/soc/microchip/pic32c/pic32cx_sg/Kconfig"
osource "/home/user/work/zephyr_dev/zephyr/soc/microchip/pic32c/pic32cm_pl/Kconfig"
osource "/home/user/work/zephyr_dev/zephyr/soc/microchip/pic32c/pic32cm_jh/Kconfig"
osource "/home/user/work/zephyr_dev/zephyr/soc/microchip/miv/Kconfig"
osource "/home/user/work/zephyr_dev/zephyr/soc/microchip/mec/Kconfig"
osource "/home/user/work/zephyr_dev/zephyr/soc/mediatek/mt8xxx/Kconfig"
osource "/home/user/work/zephyr_dev/zephyr/soc/lowrisc/opentitan/Kconfig"
osource "/home/user/work/zephyr_dev/zephyr/soc/litex/Kconfig"
osource "/home/user/work/zephyr_dev/zephyr/soc/ite/ec/Kconfig"
osource "/home/user/work/zephyr_dev/zephyr/soc/intel/wildcat_lake/Kconfig"
osource "/home/user/work/zephyr_dev/zephyr/soc/intel/raptor_lake/Kconfig"
osource "/home/user/work/zephyr_dev/zephyr/soc/intel/panther_lake/Kconfig"
osource "/home/user/work/zephyr_dev/zephyr/soc/intel/lakemont/Kconfig"
osource "/home/user/work/zephyr_dev/zephyr/soc/intel/intel_socfpga_std/Kconfig"
osource "/home/user/work/zephyr_dev/zephyr/soc/intel/intel_socfpga/Kconfig"
osource "/home/user/work/zephyr_dev/zephyr/soc/intel/intel_niosv/Kconfig"
osource "/home/user/work/zephyr_dev/zephyr/soc/intel/intel_ish/Kconfig"
osource "/home/user/work/zephyr_dev/zephyr/soc/intel/intel_adsp/Kconfig"
osource "/home/user/work/zephyr_dev/zephyr/soc/intel/elkhart_lake/Kconfig"
osource "/home/user/work/zephyr_dev/zephyr/soc/intel/atom/Kconfig"
osource "/home/user/work/zephyr_dev/zephyr/soc/intel/apollo_lake/Kconfig"
osource "/home/user/work/zephyr_dev/zephyr/soc/intel/alder_lake/Kconfig"
osource "/home/user/work/zephyr_dev/zephyr/soc/infineon/psoc4/Kconfig"
osource "/home/user/work/zephyr_dev/zephyr/soc/infineon/edge/Kconfig"
osource "/home/user/work/zephyr_dev/zephyr/soc/infineon/cat3/Kconfig"
osource "/home/user/work/zephyr_dev/zephyr/soc/infineon/cat1c/Kconfig"
osource "/home/user/work/zephyr_dev/zephyr/soc/infineon/cat1b/Kconfig"
osource "/home/user/work/zephyr_dev/zephyr/soc/infineon/cat1a/Kconfig"
osource "/home/user/work/zephyr_dev/zephyr/soc/gd/gd32/Kconfig"
osource "/home/user/work/zephyr_dev/zephyr/soc/gaisler/leon3/Kconfig"
osource "/home/user/work/zephyr_dev/zephyr/soc/gaisler/gr716a/Kconfig"
osource "/home/user/work/zephyr_dev/zephyr/soc/focaltech/Kconfig"
osource "/home/user/work/zephyr_dev/zephyr/soc/espressif/Kconfig"
osource "/home/user/work/zephyr_dev/zephyr/soc/ene/kb1200/Kconfig"
osource "/home/user/work/zephyr_dev/zephyr/soc/ene/kb106x/Kconfig"
osource "/home/user/work/zephyr_dev/zephyr/soc/elan/em32f967/Kconfig"
osource "/home/user/work/zephyr_dev/zephyr/soc/egis/Kconfig"
osource "/home/user/work/zephyr_dev/zephyr/soc/efinix/sapphire/Kconfig"
osource "/home/user/work/zephyr_dev/zephyr/soc/cdns/xtensa_sample_controller/Kconfig"
osource "/home/user/work/zephyr_dev/zephyr/soc/cdns/swerv/Kconfig"
osource "/home/user/work/zephyr_dev/zephyr/soc/cdns/sample_controller32/Kconfig"
osource "/home/user/work/zephyr_dev/zephyr/soc/cdns/dc233c/Kconfig"
osource "/home/user/work/zephyr_dev/zephyr/soc/brcm/bcmvk/Kconfig"
osource "/home/user/work/zephyr_dev/zephyr/soc/brcm/bcm2712/Kconfig"
osource "/home/user/work/zephyr_dev/zephyr/soc/brcm/bcm2711/Kconfig"
osource "/home/user/work/zephyr_dev/zephyr/soc/blackberry/qnxhv_vm/Kconfig"
osource "/home/user/work/zephyr_dev/zephyr/soc/bflb/Kconfig"
osource "/home/user/work/zephyr_dev/zephyr/soc/atmel/sam0/Kconfig"
osource "/home/user/work/zephyr_dev/zephyr/soc/atmel/sam/Kconfig"
osource "/home/user/work/zephyr_dev/zephyr/soc/aspeed/Kconfig"
osource "/home/user/work/zephyr_dev/zephyr/soc/arm/Kconfig"
osource "/home/user/work/zephyr_dev/zephyr/soc/arm/beetle/Kconfig"
osource "/home/user/work/zephyr_dev/zephyr/soc/antmicro/myra/Kconfig"
osource "/home/user/work/zephyr_dev/zephyr/soc/andestech/Kconfig"
osource "/home/user/work/zephyr_dev/zephyr/soc/amd/acp_6_0/Kconfig"
osource "/home/user/work/zephyr_dev/zephyr/soc/ambiq/Kconfig"
osource "/home/user/work/zephyr_dev/zephyr/soc/allwinner/sun8i_h3/Kconfig"
osource "/home/user/work/zephyr_dev/zephyr/soc/alif/ensemble/Kconfig"
osource "/home/user/work/zephyr_dev/zephyr/soc/aesc/Kconfig"
osource "/home/user/work/zephyr_dev/zephyr/soc/adi/max32/Kconfig"
```
