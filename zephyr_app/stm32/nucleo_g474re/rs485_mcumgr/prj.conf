## CMakeLists.txt
```
cmake_minimum_required(VERSION 3.28.0)

find_package(Zephyr REQUIRED HINTS $ENV{ZEPHYR_BASE})
project(rs485_mcumgr)

target_sources(app PRIVATE
    src/main.c
    src/rs485_uart.c
    src/rs485_envelope.c
    src/smp_rs485_transport.c
)
```

## Kconfig
```
# Private config options for the rs485_mcumgr application.
#
# The two lines below just restore Zephyr's normal Kconfig tree (this file
# replaces it as KCONFIG_ROOT purely so we can add APP_RS485_SMP_TRANSPORT
# below) - same minimal pattern Zephyr's own sample apps use, e.g.
# zephyr/samples/drivers/dac/Kconfig.

mainmenu "RS485 mcumgr firmware update application"

source "Kconfig.zephyr"

config APP_RS485_SMP_TRANSPORT
	bool "Custom RS485 mcumgr SMP transport"
	default y
	select MCUMGR_TRANSPORT_SERIAL_HAS_SMP_OVER_CONSOLE
	help
	  Compiles the shared SMP-over-serial encode/decode helpers
	  (mcumgr_serial_tx_pkt/mcumgr_serial_process_frag) used by the custom
	  RS485 transport in src/smp_rs485_transport.c, without pulling in
	  CONFIG_MCUMGR_TRANSPORT_UART's built-in uart_mcumgr console driver
	  (which has no hook for RS485 DE control).

config APP_WDT_TIMEOUT_MS
	int "IWDG timeout in milliseconds"
	default 20000
	help
	  If a bad update hangs or crashes before the app reaches its main feed
	  loop, IWDG resets the board; since the new image is never
	  auto-confirmed in that case, MCUboot reverts to the last-known-good
	  image on the next boot. 20000ms is an exact reload value for this
	  chip's IWDG (LSI=32kHz, prescaler /256, reload 2499) with large
	  margin below the ~32.768s hardware ceiling.

config APP_SELF_CONFIRM_GRACE_PERIOD_S
	int "Seconds of stable running before self-confirming an unconfirmed image"
	default 300
	help
	  Safety-net fallback: if the Pi never explicitly sends `mcumgr image
	  confirm`, the device confirms itself after this many seconds of
	  continuous healthy operation, so it doesn't stay in a
	  perpetually-revertible "test" state for its whole operational life.
	  Keep this at least ~10-15x APP_WDT_TIMEOUT_MS so the two windows can
	  never straddle ambiguously.
```

## prj.conf
```kconfig
# RS485 UART + DE GPIO
CONFIG_SERIAL=y
CONFIG_GPIO=y
CONFIG_UART_INTERRUPT_DRIVEN=y

# Hardware watchdog (IWDG): production safety net for the update flow. See
# APP_WDT_TIMEOUT_MS/APP_SELF_CONFIRM_GRACE_PERIOD_S in ./Kconfig.
# IWDG_STM32 auto-enables (default y, depends on the board's already-enabled
# &iwdg devicetree node).
CONFIG_WATCHDOG=y

# Settings-backed node address provisioning (rs485_envelope.c). Falls back to
# the board's existing storage_partition automatically - no devicetree change
# needed (settings_nvs.c uses PARTITION_ID(storage_partition) when no
# zephyr,settings-partition chosen node exists).
CONFIG_SETTINGS=y
CONFIG_NVS=y
CONFIG_SETTINGS_NVS=y

# Debug console on LPUART1 (ST-LINK VCP) - a separate UART from USART1/RS485,
# safe to use for printk without disturbing the update transport.
CONFIG_CONSOLE=y
CONFIG_UART_CONSOLE=y
CONFIG_PRINTK=y
CONFIG_STDOUT_CONSOLE=y

# MCUboot image-manager, app side (same as fan_control_v2/prj.conf). IMG_MANAGER
# is needed for boot_write_img_confirmed(), and itself depends on FLASH_MAP +
# STREAM_FLASH (not auto-selected).
CONFIG_FLASH=y
CONFIG_FLASH_MAP=y
CONFIG_STREAM_FLASH=y
CONFIG_IMG_MANAGER=y
CONFIG_MCUBOOT_IMG_MANAGER=y

# mcumgr core + SMP-over-serial framing helpers. We deliberately do NOT enable
# CONFIG_MCUMGR_TRANSPORT_UART (it ties to a fixed zephyr,uart-mcumgr chosen
# console UART whose TX path can't be wrapped with RS485 DE control without
# patching a vendored Zephyr driver). Instead we drive the same shared
# encode/decode helpers (mcumgr_serial_tx_pkt/mcumgr_serial_process_frag) from
# our own transport in smp_rs485_transport.c.
CONFIG_NET_BUF=y
CONFIG_ZCBOR=y
CONFIG_BASE64=y
CONFIG_CRC=y
CONFIG_MCUMGR=y
# Selects CONFIG_MCUMGR_TRANSPORT_SERIAL_HAS_SMP_OVER_CONSOLE (see ./Kconfig) -
# that symbol has no prompt so it can't be set directly in a .conf fragment.
CONFIG_APP_RS485_SMP_TRANSPORT=y

# mcumgr command groups
CONFIG_MCUMGR_GRP_IMG=y
CONFIG_MCUMGR_GRP_OS=y

# Sizing
CONFIG_MCUMGR_TRANSPORT_NETBUF_SIZE=384
CONFIG_MCUMGR_TRANSPORT_NETBUF_COUNT=4
CONFIG_MAIN_STACK_SIZE=2048
CONFIG_SYSTEM_WORKQUEUE_STACK_SIZE=2304
```

## src/main.c
```c
#include <errno.h>
#include <zephyr/kernel.h>
#include <zephyr/device.h>
#include <zephyr/devicetree.h>
#include <zephyr/dfu/mcuboot.h>
#include <zephyr/drivers/gpio.h>
#include <zephyr/drivers/watchdog.h>
#include <zephyr/sys/printk.h>

#include "smp_rs485_transport.h"

#define LED0_NODE DT_ALIAS(led0)
#define WDT_NODE  DT_ALIAS(watchdog0)

static const struct gpio_dt_spec led0 = GPIO_DT_SPEC_GET(LED0_NODE, gpios);
static const struct device *const wdt_dev = DEVICE_DT_GET(WDT_NODE);
static int wdt_channel_id = -1;

/*
 * Safety-net fallback: if the Pi never explicitly sends `mcumgr image
 * confirm` (mgmt/mcumgr/grp/img_mgmt/src/zephyr_img_mgmt.c's
 * img_mgmt_write_confirmed() already calls boot_write_img_confirmed() for
 * that path - no device code needed for it), the device confirms itself
 * after this many seconds of continuous, healthy operation, so it doesn't
 * stay in a perpetually-revertible "test" state for its whole operational
 * life. boot_is_img_confirmed() makes this a no-op if the Pi already
 * confirmed first.
 */
static void self_confirm_work_handler(struct k_work *work)
{
	ARG_UNUSED(work);

	if (!boot_is_img_confirmed()) {
		int rc = boot_write_img_confirmed();

		printk("rs485_mcumgr: self-confirm %s\n", rc == 0 ? "ok" : "failed");
	}
}
K_WORK_DELAYABLE_DEFINE(self_confirm_work, self_confirm_work_handler);

/*
 * Arms the IWDG so a bad update that hangs/crashes gets reset rather than
 * bricking the board: since the new image is never confirmed in that case,
 * MCUboot reverts to the last-known-good image on the next boot.
 * WDT_OPT_PAUSE_HALTED_BY_DBG freezes IWDG only while a debugger has the
 * core halted at a breakpoint - a no-op in production, but removes the
 * "resets while stepping" annoyance during development.
 */
static int watchdog_arm(void)
{
	if (!device_is_ready(wdt_dev)) {
		printk("rs485_mcumgr: watchdog not ready\n");
		return -ENODEV;
	}

	struct wdt_timeout_cfg wdt_cfg = {
		.window = {.min = 0, .max = CONFIG_APP_WDT_TIMEOUT_MS},
		.callback = NULL,
		.flags = WDT_FLAG_RESET_SOC,
	};

	wdt_channel_id = wdt_install_timeout(wdt_dev, &wdt_cfg);
	if (wdt_channel_id < 0) {
		printk("rs485_mcumgr: wdt_install_timeout failed: %d\n", wdt_channel_id);
		return wdt_channel_id;
	}

	return wdt_setup(wdt_dev, WDT_OPT_PAUSE_HALTED_BY_DBG);
}

int main(void)
{
	int ret;

	printk("rs485_mcumgr: starting (blinky v2)\n");

	ret = watchdog_arm();
	if (ret != 0) {
		printk("rs485_mcumgr: continuing without watchdog: %d\n", ret);
	}

	if (!gpio_is_ready_dt(&led0)) {
		printk("rs485_mcumgr: led0 not ready\n");
		return 0;
	}

	ret = gpio_pin_configure_dt(&led0, GPIO_OUTPUT_INACTIVE);
	if (ret != 0) {
		printk("rs485_mcumgr: led0 configure failed: %d\n", ret);
		return 0;
	}

	ret = smp_rs485_transport_init();
	if (ret != 0) {
		printk("rs485_mcumgr: transport init failed: %d\n", ret);
		return 0;
	}

	printk("rs485_mcumgr: ready, mcumgr reachable over RS485\n");

	/*
	 * Do NOT confirm immediately - give the Pi a chance to verify the new
	 * image is actually healthy and confirm it explicitly first. Schedule
	 * the grace-period fallback in case it never gets around to it.
	 */
	k_work_schedule(&self_confirm_work, K_SECONDS(CONFIG_APP_SELF_CONFIRM_GRACE_PERIOD_S));

	while (1) {
		gpio_pin_toggle_dt(&led0);
		if (wdt_channel_id >= 0) {
			wdt_feed(wdt_dev, wdt_channel_id);
		}
		k_msleep(200);
	}

	return 0;
}
```

## src/rs485_envelope.h
```c
#ifndef RS485_ENVELOPE_H_
#define RS485_ENVELOPE_H_

#include <stdint.h>

/*
 * Multi-drop RS485 addressing layer. Every frame on the bus carries a
 * destination address; a node only ever buffers/acts on/responds to frames
 * addressed to it (or the broadcast address), and silently, cheaply
 * discards everything else without ever transmitting - required since
 * RS485 is a shared broadcast medium and two nodes replying at once is
 * real electrical bus contention, not just a logical mixup.
 *
 * This is a general-purpose foundation: KIND_MCUMGR carries the existing
 * mcumgr/SMP transport traffic, KIND_PROVISIONING carries the one-off
 * address-assignment command, and further KIND values are reserved for a
 * future addressed application protocol on this same bus.
 */

/* Reserved/special addresses. 0x02-0xFE are provisioned node addresses. */
#define RS485_ADDR_BROADCAST     0x00
#define RS485_ADDR_HOST          0x01
#define RS485_ADDR_NODE_MIN      0x02
#define RS485_ADDR_NODE_MAX      0xFE
#define RS485_ADDR_UNPROVISIONED 0xFF

/*
 * Shared by the TX scratch buffer, the RX payload buffer, and the
 * "implausible LEN" sanity bound, so the check and the actual capacity can
 * never drift apart. Covers the worst case whole mcumgr transmission at the
 * configured MTU: simulating mcumgr_serial_tx_pkt()'s output for
 * CONFIG_MCUMGR_TRANSPORT_NETBUF_SIZE=384 gives 5 lines / 535 wire bytes
 * (MCUMGR_SERIAL_MAX_FRAME=127 per line); this leaves ~7% margin.
 */
#define RS485_ENVELOPE_MAX_PAYLOAD 576

/**
 * Initializes settings-backed address provisioning (reads this node's
 * address from flash, defaulting to RS485_ADDR_UNPROVISIONED if never set),
 * then brings up the RS485 UART/DE hardware. Must be called before
 * registering an SMP transport's rx callbacks on top of this layer.
 */
int rs485_envelope_init(void);

/**
 * Called once, from the UART ISR, per raw received byte. Runs the envelope
 * parser (resync/address/length/CRC). A frame addressed to this node (or
 * broadcast) has its payload dispatched by KIND; everything else is
 * discarded without ever transmitting a response.
 */
void rs485_envelope_rx_byte(uint8_t byte);

/**
 * Collects one chunk of outgoing mcumgr data - matches the
 * mcumgr_serial_tx_cb signature so it can be passed directly to
 * mcumgr_serial_tx_pkt(). Must be followed by exactly one
 * rs485_envelope_tx_flush() call once the whole packet has been collected.
 */
int rs485_envelope_tx_collect(const void *data, int len);

/**
 * Wraps everything collected since the last flush into one addressed
 * (KIND_MCUMGR) envelope frame destined for dest_addr and transmits it,
 * DE-guarded internally. Resets the collector for the next packet
 * regardless of outcome.
 */
int rs485_envelope_tx_flush(uint8_t dest_addr);

#endif /* RS485_ENVELOPE_H_ */
```

## src/rs485_uart.c
```c
#include "rs485_uart.h"
#include "rs485_envelope.h"

#include <errno.h>
#include <zephyr/device.h>
#include <zephyr/devicetree.h>
#include <zephyr/drivers/gpio.h>
#include <zephyr/drivers/uart.h>
#include <zephyr/kernel.h>

#define UART_NODE     DT_NODELABEL(usart1)
#define RS485_DE_NODE DT_NODELABEL(rs485_de)

#if !DT_NODE_HAS_STATUS(UART_NODE, okay)
#error "usart1 is not enabled in devicetree"
#endif

#if !DT_NODE_HAS_STATUS(RS485_DE_NODE, okay)
#error "rs485_de node is not enabled in devicetree"
#endif

static const struct device *const uart_dev = DEVICE_DT_GET(UART_NODE);
static const struct gpio_dt_spec rs485_de = GPIO_DT_SPEC_GET(RS485_DE_NODE, gpios);

/* Fragments (complete lines) waiting to be decoded off the ISR's hands. */
K_MEM_SLAB_DEFINE(rs485_rx_slab, sizeof(struct rs485_rx_buf), RS485_RX_BUF_COUNT, 1);

static rs485_rx_frag_fn *rs485_rx_cb;
static rs485_rx_idle_fn *rs485_rx_idle_cb;
static struct rs485_rx_buf *rs485_cur_rx_buf;
static bool rs485_rx_ignoring;

/* A noise burst or aborted transfer with no trailing '\n' would otherwise
 * leave a partial line sitting forever, corrupting whatever legitimate bytes
 * arrive next. Restarted on every received byte; on expiry, discards any
 * in-progress line and lets a higher layer (the SMP transport) discard its
 * own in-progress multi-line reassembly state too via rs485_rx_idle_cb.
 */
#define RS485_RX_INACTIVITY_TIMEOUT_MS 300

static void rs485_rx_timeout_expired(struct k_timer *timer)
{
	ARG_UNUSED(timer);

	unsigned int key = irq_lock();

	if (rs485_cur_rx_buf != NULL) {
		rs485_uart_free_rx_buf(rs485_cur_rx_buf);
		rs485_cur_rx_buf = NULL;
	}
	rs485_rx_ignoring = false;

	irq_unlock(key);

	if (rs485_rx_idle_cb != NULL) {
		rs485_rx_idle_cb();
	}
}

K_TIMER_DEFINE(rs485_rx_timeout_timer, rs485_rx_timeout_expired, NULL);

static struct rs485_rx_buf *rs485_alloc_rx_buf(void)
{
	struct rs485_rx_buf *rx_buf;
	void *block;

	if (k_mem_slab_alloc(&rs485_rx_slab, &block, K_NO_WAIT) != 0) {
		return NULL;
	}

	rx_buf = block;
	rx_buf->length = 0;
	return rx_buf;
}

void rs485_uart_free_rx_buf(struct rs485_rx_buf *rx_buf)
{
	k_mem_slab_free(&rs485_rx_slab, rx_buf);
}

void rs485_uart_register_rx_cb(rs485_rx_frag_fn *cb)
{
	rs485_rx_cb = cb;
}

void rs485_uart_register_rx_idle_cb(rs485_rx_idle_fn *cb)
{
	rs485_rx_idle_cb = cb;
}

/* Accumulates one incoming (already envelope-unwrapped) payload byte;
 * dispatches to the registered rx callback once a line (terminated by '\n')
 * has been received, mirroring uart_mcumgr_rx_byte().
 *
 * rs485_cur_rx_buf/rs485_rx_ignoring are shared with the RX inactivity timer
 * (rs485_rx_timeout_expired(), a separate interrupt context) and so are
 * protected by irq_lock() here, not just implicitly single-threaded as when
 * only the UART ISR touched them.
 */
void rs485_uart_feed_payload_byte(uint8_t byte)
{
	struct rs485_rx_buf *rx_buf;
	struct rs485_rx_buf *completed = NULL;
	unsigned int key;

	/* Restart the "no byte for N ms" clock on every byte - k_timer_start()
	 * internally re-arms from now even if already running.
	 */
	k_timer_start(&rs485_rx_timeout_timer, K_MSEC(RS485_RX_INACTIVITY_TIMEOUT_MS), K_NO_WAIT);

	key = irq_lock();

	if (!rs485_rx_ignoring) {
		if (rs485_cur_rx_buf == NULL) {
			rs485_cur_rx_buf = rs485_alloc_rx_buf();
			if (rs485_cur_rx_buf == NULL) {
				rs485_rx_ignoring = true;
			}
		}
	}

	rx_buf = rs485_cur_rx_buf;
	if (!rs485_rx_ignoring) {
		if (rx_buf->length >= sizeof(rx_buf->data)) {
			rs485_uart_free_rx_buf(rs485_cur_rx_buf);
			rs485_cur_rx_buf = NULL;
			rs485_rx_ignoring = true;
		} else {
			rx_buf->data[rx_buf->length++] = byte;
		}
	}

	if (byte == '\n') {
		if (rs485_rx_ignoring) {
			rs485_rx_ignoring = false;
		} else {
			rs485_cur_rx_buf = NULL;
			completed = rx_buf;
		}
	}

	irq_unlock(key);

	if (completed != NULL && rs485_rx_cb != NULL) {
		rs485_rx_cb(completed);
	}
}

static void rs485_uart_isr(const struct device *dev, void *user_data)
{
	uint8_t buf[32];
	int chunk_len;

	ARG_UNUSED(user_data);

	while (uart_irq_update(dev) && uart_irq_is_pending(dev)) {
		if (!uart_irq_rx_ready(dev)) {
			continue;
		}

		chunk_len = uart_fifo_read(dev, buf, sizeof(buf));
		for (int i = 0; i < chunk_len; i++) {
			rs485_envelope_rx_byte(buf[i]);
		}
	}
}

void rs485_uart_de_assert(void)
{
	gpio_pin_set_dt(&rs485_de, 1);
	k_busy_wait(100);
}

void rs485_uart_de_deassert(void)
{
	/* uart_poll_out() only guarantees the shift register was free for the
	 * PREVIOUS byte, not that the LAST byte finished shifting out onto the
	 * wire - wait comfortably longer than one frame time (10 bits @ 115200
	 * baud = ~87us) before dropping DE, exactly as validated in the rs485
	 * test project.
	 */
	k_busy_wait(200);
	k_busy_wait(20);
	gpio_pin_set_dt(&rs485_de, 0);
}

int rs485_uart_raw_send(const void *data, int len)
{
	const uint8_t *p = data;

	while (len--) {
		uart_poll_out(uart_dev, *p++);
	}

	return 0;
}

int rs485_uart_init(void)
{
	if (!device_is_ready(uart_dev)) {
		return -ENODEV;
	}

	if (!gpio_is_ready_dt(&rs485_de)) {
		return -ENODEV;
	}

	int ret = gpio_pin_configure_dt(&rs485_de, GPIO_OUTPUT_INACTIVE);

	if (ret != 0) {
		return ret;
	}

	uart_irq_rx_disable(uart_dev);
	uart_irq_tx_disable(uart_dev);
	uart_irq_callback_set(uart_dev, rs485_uart_isr);
	uart_irq_rx_enable(uart_dev);

	return 0;
}
```

## src/rs485_uart.h
```c
#ifndef RS485_UART_H_
#define RS485_UART_H_

#include <stdint.h>
#include <zephyr/types.h>

/* Must satisfy RS485_RX_BUF_COUNT * RS485_RX_BUF_SIZE >= CONFIG_MCUMGR_TRANSPORT_NETBUF_SIZE,
 * mirroring the relation Zephyr's own uart_mcumgr driver documents for
 * CONFIG_UART_MCUMGR_RX_BUF_COUNT/CONFIG_UART_MCUMGR_RX_BUF_SIZE.
 */
#define RS485_RX_BUF_SIZE  128
#define RS485_RX_BUF_COUNT 4

/** A single received mcumgr-over-serial fragment (one line, up to and including '\n'). */
struct rs485_rx_buf {
	void *fifo_reserved; /* 1st word reserved for use by k_fifo */
	uint8_t data[RS485_RX_BUF_SIZE];
	int length;
};

/** Called from ISR context when a complete line has been received. */
typedef void rs485_rx_frag_fn(struct rs485_rx_buf *rx_buf);

/**
 * Called (from timer-ISR context) when no byte has arrived for
 * RS485_RX_INACTIVITY_TIMEOUT_MS - lets a higher layer (the SMP transport)
 * discard any of its own in-progress multi-line reassembly state, since the
 * line-level buffer that fed it has just been discarded too.
 */
typedef void rs485_rx_idle_fn(void);

/**
 * Brings up the USART1 device (already pinned to PC4/PC5 = Arduino D0/D1 by
 * the board's default devicetree) and the RS485 DE/RE GPIO (PA8 = Arduino D7),
 * and starts interrupt-driven RX byte capture. Must be called before any
 * other rs485_uart_* function.
 */
int rs485_uart_init(void);

/** Registers the callback invoked (from ISR context) for each completed line. */
void rs485_uart_register_rx_cb(rs485_rx_frag_fn *cb);

/**
 * Feeds one payload byte (already unwrapped/validated by the addressing
 * envelope layer, rs485_envelope.c) into the line accumulator. Invokes the
 * registered rx callback itself once a complete line ('\n'-terminated) has
 * been accumulated. Runs in ISR context (called from the envelope layer's
 * own ISR-context byte handler).
 */
void rs485_uart_feed_payload_byte(uint8_t byte);

/**
 * Registers the callback invoked (from timer-ISR context) when the RX
 * inactivity timeout fires, i.e. a partial/aborted line was just discarded.
 */
void rs485_uart_register_rx_idle_cb(rs485_rx_idle_fn *cb);

/** Returns a completed rx buffer to the pool once its contents have been processed. */
void rs485_uart_free_rx_buf(struct rs485_rx_buf *rx_buf);

/**
 * Raises DE (transmit mode) and waits for the transceiver to settle. Must be
 * paired with a subsequent rs485_uart_de_deassert() call.
 */
void rs485_uart_de_assert(void);

/**
 * Waits for the last transmitted byte to finish shifting out, then drops DE
 * (receive mode).
 */
void rs485_uart_de_deassert(void);

/**
 * Dumb byte pusher with no DE handling of its own - matches the
 * mcumgr_serial_tx_cb signature exactly so it can be passed directly to
 * mcumgr_serial_tx_pkt(). Callers must wrap it with
 * rs485_uart_de_assert()/rs485_uart_de_deassert().
 */
int rs485_uart_raw_send(const void *data, int len);

#endif /* RS485_UART_H_ */
```

## src/smp_rs485_transport.c
```c
/*
 * Custom mcumgr SMP transport carrying SMP-over-serial (base64 + CRC16)
 * framing over the RS485 link, reusing Zephyr's own shared encode/decode
 * helpers (mcumgr_serial_tx_pkt/mcumgr_serial_process_frag - the same ones
 * zephyr/subsys/mgmt/mcumgr/transport/src/smp_uart.c uses) instead of
 * CONFIG_MCUMGR_TRANSPORT_UART, since that built-in transport's raw TX path
 * (uart_mcumgr_send_raw() in zephyr/drivers/console/uart_mcumgr.c) is a plain
 * uart_poll_out() loop with no hook for RS485 DE control, and it's tied to a
 * fixed zephyr,uart-mcumgr chosen device we'd rather not repurpose.
 *
 * This file mirrors smp_uart.c's fifo+work deferred-decode structure almost
 * exactly; the only real differences are the underlying UART device/ISR
 * (rs485_uart.c, not the vendored uart_mcumgr driver) and wrapping the whole
 * mcumgr_serial_tx_pkt() call with RS485 DE assert/deassert.
 *
 * smp_rx_req()/smp_packet_free() come from
 * mgmt/mcumgr/transport/smp_internal.h, which lives outside include/zephyr/
 * and is not a documented stable API - it's the same internal header
 * smp_uart.c itself relies on, and there's no public alternative for this.
 * Worth re-checking against this file on future Zephyr version bumps.
 */

#include "smp_rs485_transport.h"
#include "rs485_envelope.h"
#include "rs485_uart.h"

#include <zephyr/init.h>
#include <zephyr/kernel.h>
#include <zephyr/net_buf.h>
#include <zephyr/mgmt/mcumgr/smp/smp.h>
#include <zephyr/mgmt/mcumgr/transport/smp.h>
#include <zephyr/mgmt/mcumgr/transport/serial.h>

#include <mgmt/mcumgr/transport/smp_internal.h>

static void smp_rs485_process_rx_queue(struct k_work *work);

K_FIFO_DEFINE(smp_rs485_rx_fifo);
K_WORK_DEFINE(smp_rs485_work, smp_rs485_process_rx_queue);

static struct mcumgr_serial_rx_ctxt smp_rs485_rx_ctxt;
static struct smp_transport smp_rs485_transport;

/** Processes a single completed line (fragment) off the deferred work queue. */
static void smp_rs485_process_frag(struct rs485_rx_buf *rx_buf)
{
	struct net_buf *nb;

	nb = mcumgr_serial_process_frag(&smp_rs485_rx_ctxt, rx_buf->data, rx_buf->length);

	rs485_uart_free_rx_buf(rx_buf);

	if (nb != NULL) {
		smp_rx_req(&smp_rs485_transport, nb);
	}
}

static void smp_rs485_process_rx_queue(struct k_work *work)
{
	ARG_UNUSED(work);

	struct rs485_rx_buf *rx_buf;

	while ((rx_buf = k_fifo_get(&smp_rs485_rx_fifo, K_NO_WAIT)) != NULL) {
		smp_rs485_process_frag(rx_buf);
	}
}

/** Enqueues a received fragment for later processing. Runs in ISR context. */
static void smp_rs485_rx_frag(struct rs485_rx_buf *rx_buf)
{
	k_fifo_put(&smp_rs485_rx_fifo, rx_buf);
	k_work_submit(&smp_rs485_work);
}

/*
 * mcumgr_serial_process_frag() reassembles a whole SMP packet across
 * multiple lines (a PKT line plus FRAG continuation lines) into
 * smp_rs485_rx_ctxt.nb - MCUMGR_SERIAL_MAX_FRAME is only 127 bytes vs our
 * 384-byte MTU, so this routinely spans multiple lines. If the RS485 line
 * buffer feeding it was just discarded by rs485_uart's inactivity timeout
 * (a dropped/corrupted continuation line), this in-progress net_buf would
 * otherwise leak forever, eventually exhausting the whole
 * CONFIG_MCUMGR_TRANSPORT_NETBUF_COUNT pool shared by all of mcumgr. Runs
 * in timer-ISR context; smp_packet_free() is net_buf-unref based and
 * ISR-safe, so no k_work deferral is needed here.
 */
static void smp_rs485_rx_idle(void)
{
	if (smp_rs485_rx_ctxt.nb != NULL) {
		smp_packet_free(smp_rs485_rx_ctxt.nb);
		smp_rs485_rx_ctxt.nb = NULL;
	}
}

static uint16_t smp_rs485_get_mtu(const struct net_buf *nb)
{
	ARG_UNUSED(nb);

	return CONFIG_MCUMGR_TRANSPORT_NETBUF_SIZE;
}

static int smp_rs485_tx_pkt(struct net_buf *nb)
{
	int rc;

	/* mcumgr_serial_tx_pkt() invokes its raw callback many times per
	 * packet (once per ~3-4 base64-encoded bytes) - rs485_envelope_tx_collect()
	 * just buffers each chunk; rs485_envelope_tx_flush() wraps the WHOLE
	 * collected packet in one addressed envelope frame and sends it
	 * DE-guarded as a single contiguous write, once the total length is
	 * known. Toggling DE per-callback instead would fragment one
	 * continuous transmission into dozens of DE toggles per packet.
	 */
	rc = mcumgr_serial_tx_pkt(nb->data, nb->len, rs485_envelope_tx_collect);
	rs485_envelope_tx_flush(RS485_ADDR_HOST);

	smp_packet_free(nb);

	return rc;
}

int smp_rs485_transport_init(void)
{
	int rc;

	rc = rs485_envelope_init();
	if (rc != 0) {
		return rc;
	}

	smp_rs485_transport.functions.output = smp_rs485_tx_pkt;
	smp_rs485_transport.functions.get_mtu = smp_rs485_get_mtu;

	rc = smp_transport_init(&smp_rs485_transport);
	if (rc != 0) {
		return rc;
	}

	rs485_uart_register_rx_cb(smp_rs485_rx_frag);
	rs485_uart_register_rx_idle_cb(smp_rs485_rx_idle);

	return 0;
}
```

## src/smp_rs485_transport.h
```c
#ifndef SMP_RS485_TRANSPORT_H_
#define SMP_RS485_TRANSPORT_H_

/**
 * Brings up the RS485 UART/DE hardware and registers the custom mcumgr SMP
 * transport on top of it. Must be called once at startup, after which mcumgr
 * commands (image upload/list/test/confirm, echo, reset) can be received over
 * the RS485 link.
 */
int smp_rs485_transport_init(void);

#endif /* SMP_RS485_TRANSPORT_H_ */
```
